#include <behaviors.dtsi>
#include <dt-bindings/zmk/keys.h>

#define PIN_MACRO(name, pin) \
/ { \
    macros { \
        name: name { \
            compatible = "zmk,behavior-macro"; \
            wait-ms = <5>; \
            tap-ms = <5>; \
            #binding-cells = <0>; \
            bindings = <&kp P &kp I &kp N &kp SPACE>, pin, <&kp ENTER>; \
        }; \
    }; \
};

PIN_MACRO(pin0, <&kp N0 &kp N0 &kp N8>)
PIN_MACRO(pin1, <&kp N0 &kp N0 &kp N6>)
PIN_MACRO(pin2, <&kp N0 &kp N1 &kp N7>)
PIN_MACRO(pin3, <&kp N0 &kp N2 &kp N0>)
PIN_MACRO(pin4, <&kp N0 &kp N2 &kp N2>)
PIN_MACRO(pin5, <&kp N0 &kp N2 &kp N4>)
PIN_MACRO(pin6, <&kp N1 &kp N0 &kp N0>)
PIN_MACRO(pin7, <&kp N0 &kp N1 &kp N1>)
PIN_MACRO(pin8, <&kp N1 &kp N0 &kp N4>)
PIN_MACRO(pin9, <&kp N1 &kp N0 &kp N6>)
PIN_MACRO(pin10, <&kp N0 &kp N0 &kp N9>)
PIN_MACRO(pin14, <&kp N1 &kp N1 &kp N1>)
PIN_MACRO(pin15, <&kp N1 &kp N1 &kp N3>)
PIN_MACRO(pin16, <&kp N0 &kp N1 &kp N0>)
PIN_MACRO(pin18, <&kp N1 &kp N1 &kp N5>)
PIN_MACRO(pin19, <&kp N0 &kp N0 &kp N2>)
PIN_MACRO(pin20, <&kp N0 &kp N2 &kp N9>)
PIN_MACRO(pin21, <&kp N0 &kp N3 &kp N1>)
PIN_MACRO(pin22, <&kp N1 &kp N0 &kp N1>)
PIN_MACRO(pin23, <&kp N1 &kp N0 &kp N2>)
PIN_MACRO(pin24, <&kp N1 &kp N0 &kp N7>)

/ {
    keymap {
        compatible = "zmk,keymap";

        default_layer {
            bindings = <&pin0
                        &pin1
                        &pin2
                        &pin3
                        &pin4
                        &pin5
                        &pin6
                        &pin7
                        &pin8
                        &pin9
                        &pin10
                        &pin14
                        &pin15
                        &pin16
                        &pin18
                        &pin19
                        &pin20
                        &pin21
                        &pin22
                        &pin23
                        &pin24>;
        };
    };
};
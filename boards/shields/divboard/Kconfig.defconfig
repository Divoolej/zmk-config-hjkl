## boards/shields/divboard/Kconfig.defconfig
```kconfig
if SHIELD_DIVBOARD_LEFT
    config ZMK_KEYBOARD_NAME
        default "DivBoard"

    config USB_DEVICE_MANUFACTURER
        default "Divoolej"

    config ZMK_SPLIT_ROLE_CENTRAL
        default y

    config BT_MAX_CONN
        default 6

    config BT_MAX_PAIRED
        default 6
endif

if SHIELD_DIVBOARD_LEFT || SHIELD_DIVBOARD_RIGHT
    config ZMK_BLE
        default y
        
    config ZMK_SPLIT
        default y

    config ZMK_POINTING
        default y
endif
```

## boards/shields/divboard/Kconfig.shield
```kconfig
config SHIELD_DIVBOARD_LEFT
    def_bool $(shields_list_contains,divboard_left)

config SHIELD_DIVBOARD_RIGHT
    def_bool $(shields_list_contains,divboard_right)
```

## boards/shields/divyoku/Kconfig.defconfig
```kconfig
if SHIELD_DIVYOKU_LEFT
    config ZMK_KEYBOARD_NAME
        default "divyoku"

    config ZMK_SPLIT_ROLE_CENTRAL
        default y
endif

if SHIELD_DIVYOKU_LEFT || SHIELD_DIVYOKU_RIGHT
    config ZMK_BLE
        default y
        
    config ZMK_SPLIT
        default y
endif
```

## boards/shields/divyoku/Kconfig.shield
```kconfig
config SHIELD_DIVYOKU_LEFT
    def_bool $(shields_list_contains,divyoku_left)

config SHIELD_DIVYOKU_RIGHT
    def_bool $(shields_list_contains,divyoku_right)
```

## boards/shields/pin_tester/Kconfig.defconfig
```kconfig
if SHIELD_PIN_TESTER

config ZMK_KEYBOARD_NAME
    default "Pin Tester"

config ZMK_BLE
    def_bool n

config SETTINGS
    def_bool n

endif
```

## boards/shields/tester_foo/Kconfig.defconfig
```kconfig
if SHIELD_TESTER_FOO

config ZMK_KEYBOARD_NAME
    default "Foo"

config ZMK_BLE
    def_bool n

config SETTINGS
    def_bool n

endif
```

## config/west.yml
```yaml
manifest:
  remotes:
    - name: zmkfirmware
      url-base: https://github.com/zmkfirmware
    - name: Divoolej
      url-base: https://github.com/Divoolej
  projects:
    - name: zmk
      remote: zmkfirmware
      revision: main
      import: app/west.yml
    - name: zmk-behavior-divled
      remote: Divoolej
      revision: main
      import: west.yml
  self:
    path: config
```

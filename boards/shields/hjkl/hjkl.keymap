#include <behaviors.dtsi>
#include <dt-bindings/zmk/keys.h>
#include <dt-bindings/zmk/bt.h>

/ {
	keymap {
		compatible = "zmk,keymap";

		default_layer {
			bindings = <
				&kp 0
				&kp 1
				&kp 2
				&kp 3
				&kp 4
				&kp 5
				&kp 6
				&kp 7
				&kp 8
				&kp 9
				&kp A
				&kp B
				&kp C
				&kp D
				&kp E
				&kp F
				&kp G
				&kp H
			>;
		};
	};
};
